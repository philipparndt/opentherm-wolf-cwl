## esp32-rust/sdkconfig.defaults
```kconfig
# Rust often requires a large task stack
CONFIG_ESP_MAIN_TASK_STACK_SIZE=8192
CONFIG_PTHREAD_TASK_STACK_SIZE_DEFAULT=8192

# Enable NVS
CONFIG_NVS_ENCRYPTION=n

# Enable WiFi
CONFIG_ESP_WIFI_ENABLED=y

# Enable Ethernet (for Olimex ESP32-POE)
CONFIG_ETH_ENABLED=y

# Enable SNTP for NTP time sync
CONFIG_LWIP_SNTP_MAX_SERVERS=1

# Enable mDNS
CONFIG_MDNS_ENABLED=y
CONFIG_MDNS_MAX_INTERFACES=3

# HTTP server
CONFIG_HTTPD_MAX_REQ_HDR_LEN=1024
CONFIG_HTTPD_MAX_URI_LEN=512
CONFIG_HTTPD_MAX_URI_HANDLERS=20

# MQTT
CONFIG_MQTT_BUFFER_SIZE=1024

# Partition table — use default for now
# SPIFFS partition is flashed separately using the C++ partition layout
CONFIG_PARTITION_TABLE_SINGLE_APP=y
```
